## Kconfig.intel
```kconfig
# Copyright (c) 2020-2022 Intel Corp.
# SPDX-License-Identifier: Apache-2.0

menu "Intel Internal"

rsource "drivers/Kconfig"
rsource "subsys/Kconfig"
endmenu
```

## drivers/Kconfig
```kconfig
# Copyright (c) 2021 Intel Corp.
# SPDX-License-Identifier: Apache-2.0

menu "Device Drivers"

orsource "$(ARCH)/ethernet/Kconfig"
rsource "dma/Kconfig"
rsource "ipc/Kconfig"
rsource "serial/Kconfig"
rsource "spi/Kconfig"
rsource "tgpio/Kconfig"
rsource "can/Kconfig"
rsource "pwm/Kconfig"
rsource "disk/Kconfig"
endmenu
```

## drivers/can/Kconfig
```kconfig
# Copyright (c) 2021 Intel Corp.
# SPDX-License-Identifier: Apache-2.0

config CAN_IOCTL
	bool "ioctl support for CAN"
	help
	Enable ioctl support for CAN

config CAN_INSTANCE
	bool "Support for can instance when multiple instances present"
	help
	Enable support for can instance when multiple instances present

rsource "Kconfig.can_intel"
```

## drivers/can/Kconfig.can_intel
```kconfig
# Copyright (c) 2021 Intel Corp.
# SPDX-License-Identifier: Apache-2.0

menuconfig CAN_INTEL
	bool "CAN Driver"
	select HAS_INTEL
	select INTEL_CAN
	select CAN_IOCTL
	select CAN_INSTANCE
	help
	  This option enables the CAN driver.
	  This driver is shim driver based on the CAN driver
	  provided by the HAL.

config FD_MODE
	bool "Enable CAN FD mode"
	default n
	select CAN_HAS_CANFD
	depends on CAN_INTEL
	help
	  Enable CAM FD mode

config SOCKET_CAN
	bool "Enable socket CAN support"
	depends on CAN_INTEL
	help
	  Enable Socket CAN support

if CAN_INTEL

config CAN_RX_TIMESTAMP
	bool "Support for timestamping in received CAN frames"
	default y
	help
	Enable support for timestamping in received CAN frames

config CAN_BRP
	int "brp"
	default 19
	range 0 31

config CAN_FAST_BRP
	int "fast_brp"
	default 19
	range 0 31

config CAN_DISABLE_AUTO_RETRANSMIT
	bool  "Disable auto retransmit for tx failures"
	help
	  Define auto retransmit behaviour for tx failures

config CAN0_STD_FILTER_COUNT
	int "can0_std_filter_cnt"
	default 128
	range 0 128

config CAN0_EXT_FILTER_COUNT
	int "can0_ext_filter_cnt"
	default 64
	range 0 64

config CAN0_RX_FIFO0_COUNT
	int "can0_rx_fifo0_cnt"
	default 64
	range 0 64

config CAN0_RX_FIFO1_COUNT
	int "can0_rx_fifo1_cnt"
	default 0
	range 0 64

config CAN0_RX_BUF_COUNT
	int "can0_rx_buf_cnt"
	default 64
	range 0 64

config CAN0_TX_EVENT_FIFO_COUNT
	int "can0_tx_evt_fifo_cnt"
	default 0
	range 0 32

config CAN0_TX_BUF_COUNT
	int "can0_tx_buf_cnt"
	default 16
	range 0 32
	help
	  Total count for TX BUF and TX FIFO should not more than 32

config CAN0_TX_FIFO_COUNT
	int "can0_tx_fifo_cnt"
	default 16
	range 0 32
	help
	  Total count for TX BUF and TX FIFO should not more than 32

config CAN0_RX_FIFO0_SIZE
	int "can0_rx_fifo0_size"
	default 64
	range 8 64
	help
	  Size of buffer elements in FIFO valid values are 8 12 16 20 24 32 48 64

config CAN0_RX_FIFO1_SIZE
	int "can0_rx_fifo1_size"
	default 8
	range 8 64
	help
	  Size of buffer elements in FIFO valid values are 8 12 16 20 24 32 48 64

config CAN0_RX_BUF_SIZE
	int "can0_rx_buf_size"
	default 64
	range 8 64
	help
	  Size of RX buffer elements valid values are 8 12 16 20 24 32 48 64

config CAN0_TX_BUF_SIZE
	int "can0_tx_buf_size"
	default 64
	range 8 64
	help
	  Size of TX buffer elements valid values are 8 12 16 20 24 32 48 64

config CAN0_RX_FIFO0_WM
	int "can0_rx_fifo0_wm"
	default 2
	range 0 64

config CAN0_RX_FIFO1_WM
	int "can0_rx_fifo1_wm"
	default 2
	range 0 64

config CAN0_TX_EVT_FIFO_WM
	int "can0_tx_evt_fifo_wm"
	default 1
	range 0 32

config CAN0_GFC_REJECT
	int "can0_gfc_reject"
	default 0
	range 0 1

config CAN0_GFC_REMOTE_REJECT
	int "can0_gfc_remote_reject"
	default 0
	range 0 1

config CAN0_TIME_COUNT
	int "can0_time_counter"
	default 1

config CAN1_STD_FILTER_COUNT
	int "can1_std_filter_cnt"
	default 32
	range 0 32

config CAN1_EXT_FILTER_COUNT
	int "can1_ext_filter_cnt"
	default 32
	range 0 32

config CAN1_RX_FIFO0_COUNT
	int "can1_rx_fifo0_cnt"
	default 32
	range 0 32

config CAN1_RX_FIFO1_COUNT
	int "can1_rx_fifo1_cnt"
	default 4
	range 0 32

config CAN1_RX_BUF_COUNT
	int "can1_rx_buf_cnt"
	default 32
	range 0 32

config CAN1_TX_EVENT_FIFO_COUNT
	int "can1_tx_evt_fifo_cnt"
	default 1
	range 0 32

config CAN1_TX_BUF_COUNT
	int "can1_tx_buf_cnt"
	default 16
	range 0 32
	help
	  Total count for TX BUF and TX FIFO should not more than 32

config CAN1_TX_FIFO_COUNT
	int "can1_tx_fifo_cnt"
	default 16
	range 0 32
	help
	  Total count for TX BUF and TX FIFO should not more than 32

config CAN1_RX_FIFO0_SIZE
	int "can1_rx_fifo0_size"
	default 64
	range 8 64
	help
	  Size of buffer elements in FIFO valid values are 8 12 16 20 24 32 48 64

config CAN1_RX_FIFO1_SIZE
	int "can1_rx_fifo1_size"
	default 64
	range 8 64
	help
	  Size of buffer elements in FIFO valid values are 8 12 16 20 24 32 48 64

config CAN1_RX_BUF_SIZE
	int "can1_rx_buf_size"
	default 64
	range 8 64
	help
	  Size of RX buffer elements valid values are 8 12 16 20 24 32 48 64

config CAN1_TX_BUF_SIZE
	int "can1_tx_buf_size"
	default 64
	range 8 64
	help
	  Size of TX buffer elements valid values are 8 12 16 20 24 32 48 64

config CAN1_RX_FIFO0_WM
	int "can1_rx_fifo0_wm"
	default 2
	range 0 32

config CAN1_RX_FIFO1_WM
	int "can1_rx_fifo1_wm"
	default 2
	range 0 32

config CAN1_TX_EVT_FIFO_WM
	int "can1_tx_evt_fifo_wm"
	default 1
	range 0 32

config CAN1_GFC_REJECT
	int "can1_gfc_reject"
	default 0
	range 0 1

config CAN1_GFC_REMOTE_REJECT
	int "can1_gfc_remote_reject"
	default 0
	range 0 1

config CAN1_TIME_COUNT
	int "can1_time_counter"
	default 1

endif #CAN_INTEL
```

## drivers/disk/Kconfig.emmc
```kconfig
# Kconfig - INTEL eMMC configuration options
#
# Copyright (c) 2021 Intel Corporation
#
# SPDX-License-Identifier: Apache-2.0
#

menuconfig EMMC_INTEL
	bool "Enable INTEL eMMC driver"
	select HAS_INTEL
	select INTEL_EMMC
	help
	  INTEL eMMC driver.

config EMMC_VOLUME_NAME
	string "eMMC Disk mount point or drive name"
	default "SD" if FAT_FILESYSTEM_ELM
	default "SDMMC"
	help
	  Disk name as per file system naming guidelines.

config EMMC_BUS_WIDTH
	int "Configure emmc bus width"
	default 8
	help
	  Configure eMMC bus width. Valid values: 1, 4 or 8.

config FS_FATFS_FORMAT_OPTION
	hex "Format options for formating volume"
	default 0x02

module = EMMC
module-str = emmc
source "subsys/logging/Kconfig.template.log_config"
```

## drivers/dma/Kconfig
```kconfig
# Kconfig - DMA configuration options
#
#
# Copyright (c) 2021 Intel Corporation
#
# SPDX-License-Identifier: Apache-2.0
#

#
# DMA options
#

rsource "Kconfig.dma_intel"
```

## drivers/dma/Kconfig.dma_intel
```kconfig
# Kconfig - INTEL DMA configuration options
#
#
# Copyright (c) 2021 Intel Corporation
#
# SPDX-License-Identifier: Apache-2.0
#

menuconfig DMA_INTEL
	bool "Enable INTEL DMA driver"
	select HAS_DTS_DMA
	select DMA_64BIT
	select HAS_INTEL
	select INTEL_DMA
	depends on DMA
	help
	  INTEL DMA driver.

config LL_SLAB_COUNT
	int "Link List slab count"
	default 128
	help
	  Number of Linked List Slab count

config BLOCK_SLAB_COUNT
	int "Block slab count"
	default 128
	help
	  Max number of Block Slab count
```

## drivers/ipc/Kconfig
```kconfig
# Kconfig - IPC configuration options

#
# Copyright (c) 2021 Intel Corporation
#
# SPDX-License-Identifier: Apache-2.0
#

#
# IPC options
#
menuconfig IPC
	bool "IPC Drivers"
	help
	  Enable IPC Driver Configuration

if IPC

module = IPC
module-str = ipc
source "subsys/logging/Kconfig.template.log_config"

rsource "Kconfig.ipc_intel"
endif # IPC
```

## drivers/ipc/Kconfig.ipc_intel
```kconfig
#
# Copyright (c) 2021 Intel Corporation
#
# SPDX-License-Identifier: Apache-2.0
#

menuconfig IPC_INTEL
	bool "IPC driver for PSE"
	select HAS_INTEL
```

## drivers/pwm/Kconfig.pwm_intel
```kconfig
# Kconfig.sedi - SEDI PWM configuration options
#
# Copyright (c) 2021 Intel Corporation
#
# SPDX-License-Identifier: Apache-2.0
#

menuconfig PWM_INTEL
	bool "SEDI PWM driver"
	select HAS_INTEL
	select INTEL_PWM
	help
	Enable the PWM driver found on Intel Microcontroller
	boards.
```

## drivers/serial/Kconfig
```kconfig
# Kconfig - serial driver configuration options

#
# Copyright (c) 2014-2015 Wind River Systems, Inc.
#
# SPDX-License-Identifier: Apache-2.0
#

config UART_RS_485
	bool "Enable RS-485 support"
	help
	  This option adds supprt for RS485 mode of operation.
	  Default operation would be in RS232 mode and can be configured to
	  enable RS485 mode of operation using RS485 APIs

config UART_9_BIT
	bool "Enable 9-bit operation support"
	help
	  This option enables support for 9-bit operation in UART

rsource "Kconfig.uart_intel"
```

## drivers/serial/Kconfig.uart_intel
```kconfig
menuconfig UART_INTEL
	bool "PSE UART driver"
	select SERIAL_HAS_DRIVER
	select SERIAL_SUPPORT_INTERRUPT
	select SERIAL_SUPPORT_ASYNC
	select HAS_INTEL
	select INTEL_UART
	help
	  This option enables the PSE UART driver.
	  This driver is simply a shim driver based on the UART driver
	  provided by the PSE BSP.

config UART_INTEL_USE_DMA
	depends on UART_INTEL
	bool "USE UART DMA for Asynchronous Transfers"
	select DMA
	select DMA_INTEL
	help
	 This option enables UART DMA feature to be used for asynchrounous
	 data transfers. All Tx operaton are done using dma channel 0 and
	 all Rx operations are done using dma channel 1.
```

## drivers/spi/Kconfig
```kconfig
# Kconfig - SPI driver configuration options

#
# Copyright (c) 2021 Intel Corporation
#
# SPDX-License-Identifier: Apache-2.0
#

rsource "Kconfig.spi_intel"
```

## drivers/spi/Kconfig.spi_intel
```kconfig
menuconfig SPI_INTEL
	bool "PSE SPI driver"
	select HAS_INTEL
	select INTEL_SPI
	default y if SPI && BOARD_EHL_CRB
	help
	  This option enables the PSE SPI driver.
	  This driver is simply a shim driver based on the SPI HAL
	  provided by the PSE BSP.

config SPI_INTEL_USE_DMA
	depends on SPI_INTEL
	bool "USE SPI DMA for Asynchronous Transfers"
	select DMA
	select DMA_INTEL
	help
	 This option enables UART DMA feature to be used for asynchrounous
	 data transfers. All Tx operaton are done using dma channel 0 and
	 all Rx operations are done using dma channel 1.
```

## drivers/tgpio/Kconfig
```kconfig
# Kconfig - INTEL TGPIO configuration options
#
#
# Copyright (c) 2021 Intel Corporation
#
# SPDX-License-Identifier: Apache-2.0
#
menuconfig GPIO_TIMED_INTEL
	bool "Intel Timed GPIO driver"
	select HAS_INTEL
	select INTEL_TGPIO
	help
	Intel TGPIO driver found on Intel Microcontroller
	boards
```

## drivers/x86/ethernet/Kconfig
```kconfig
# Kconfig -  Ethernet drivers configuration options

#
# Copyright (c) 2015 Intel Corporation
#
# SPDX-License-Identifier: Apache-2.0
#

menu "Ethernet Drivers"
	depends on NET_L2_ETHERNET

module = ETH
module-dep = LOG
module-str = Log level for Ethernet driver
module-help = Sets log level for Ethernet Device Drivers.
source "subsys/net/Kconfig.template.log_config.net"

config ETH_INIT_PRIORITY
	int "Ethernet driver init priority"
	default 80
	help
	  Ethernet device driver initialization priority.
	  Do not mess with it unless you know what you are doing.
	  Note that the priority needs to be lower than the net stack
	  so that it can start before the networking sub-system.

rsource "Kconfig.phy"
rsource "Kconfig.eth_phy_marvell"
rsource "Kconfig.eth_gen_phy"
rsource "Kconfig.dwc_eqos_v5"
endmenu # "Ethernet Drivers"
```
