## dts/bindings/pwm/intel,ia-pwm.yaml
```yaml
# Copyright (c) 2021 Intel Corporation
#
# SPDX-License-Identifier: Apache-2.0
---
description: INTEL PSE PWM

compatible: "intel,ia-pwm"

include: base.yaml

properties:
    reg:
      required: true
```

## dts/bindings/serial/intel,ia-uart.yaml
```yaml
# Copyright (c) 2021 Intel Corporation
#
# SPDX-License-Identifier: Apache-2.0
---
description: INTEL PSE UART

compatible: "intel,ia-uart"

include: uart-controller.yaml

properties:
    reg:
      required: true

    interrupts:
      required: true

    peripheral-id:
      type: int
      description: peripheral instance for UART
      required: true

    dma-rx-chnl-id:
      type: int
      description: peripheral instance for UART
      required: true

    dma-tx-chnl-id:
      type: int
      description: peripheral instance for UART
      required: true
```

## dts/bindings/spi/intel,spi.yaml
```yaml
# Copyright (c) 2021 Intel Corporation
#
# SPDX-License-Identifier: Apache-2.0
---
description: Intel SPI

compatible: "intel,spi"

include: spi-controller.yaml

properties:
    reg:
      required: true

    interrupts:
      required: true

    peripheral-id:
      type: int
      description: Peripheral instance id
      required: true
```

## dts/bindings/tgpio/intel,ia-tgpio.yaml
```yaml
# Copyright (c) 2021 Intel Corporation
# SPDX-License-Identifier: Apache-2.0

description: Intel Elkhart Lake TGPIO node

compatible: "intel,ia-tgpio"

include: [base.yaml]

properties:
    reg:
      required: true

    label:
      required: true

    interrupts:
      required: true

    pin-mux:
      type: int
      description: Pin multiplexer setting for TGPIO
      required: true
```

## modules/hal_intel/Kconfig
```kconfig
# Copyright (c) 2021 Intel Corporation.
# SPDX-License-Identifier: Apache-2.0

config HAS_INTEL
	bool

menu "intel hal drivers"
	depends on HAS_INTEL

config INTEL_DMA
	bool "Enable DMA driver"

config INTEL_UART
	bool "Enable UART driver"

config INTEL_SPI
	bool "Enable SPI driver"

config INTEL_TGPIO
	bool "Enable Time-Aware GPIO driver"

config INTEL_PWM
	bool "Enable PWM driver"

config INTEL_EMMC
	bool "Enable eMMC driver"

config INTEL_CAN
	bool "Enable CAN driver"

config INTEL_IPC
	bool "Enable IPC driver"

endmenu
```

## soc/Kconfig
```kconfig
# SPDX-License-Identifier: Apache-2.0


#
# SOC_*_LD: SoC specific Linker script additions
#

if ARC || ARM || X86 || NIOS2 || RISCV

config SOC_NOINIT_LD
	bool
	help
	  Note: This is deprecated, use Cmake function zephyr_linker_sources() instead.
	  Include an SoC specific linker script fragment named soc-noinit.ld
	  for inserting additional data and linker directives into
	  the noinit section.

	  This only has effect if the SoC uses the common linker script
	  under include/arch/.

config SOC_RODATA_LD
	bool
	help
	  Note: This is deprecated, use Cmake function zephyr_linker_sources() instead.
	  Include an SoC specific linker script fragment named soc-rodata.ld
	  for inserting additional data and linker directives into
	  the rodata section.

	  This only has effect if the SoC uses the common linker script
	  under include/arch/.

config SOC_RWDATA_LD
	bool
	help
	  Note: This is deprecated, use Cmake function zephyr_linker_sources() instead.
	  Include an SoC specific linker script fragment named soc-rwdata.ld
	  for inserting additional data and linker directives into
	  the data section.

	  This only has effect if the SoC uses the common linker script
	  under include/arch/.

endif # ARC || ARM || X86 || NIOS2 || RISCV

config SOC_DEPRECATED_RELEASE
	string
	help
	  This hidden option is set in the SoC configuration and indicates
	  the Zephyr release that the SoC configuration will be removed.
	  When set, any build for that SoC will generate a clearly visible
	  deprecation warning.
```

## subsys/Kconfig
```kconfig
# Copyright (c) 2021-2022 Intel Corp.
# SPDX-License-Identifier: Apache-2.0

rsource "logging/Kconfig"
```

## subsys/logging/Kconfig
```kconfig
# Copyright (c) 2021-2022 Intel Corp.
# SPDX-License-Identifier: Apache-2.0

if LOG
config LOG_BACKEND_DTF
	bool "Enable DTF backend"
	default n
	help
	  When enabled backend is using DTF to output logs.

endif # LOG
```
