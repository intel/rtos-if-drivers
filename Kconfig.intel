## drivers/x86/ethernet/Kconfig.eth_gen_phy
```kconfig
# Kconfig - Generic Phy driver configuration options

#
# Copyright (c) 2020 Intel Corporation
#
# SPDX-License-Identifier: Apache-2.0
#
menuconfig ETH_PHY_GEN_PHY
	bool
	prompt "Generic Phy driver"
	depends on NET_L2_ETHERNET
	select ETH_PHY
	select ETH_PHY_USE_C22
	select ETH_PHY_POLLING_MODE
	default n
	help
	  Enable Generic Phy driver.

if ETH_PHY_GEN_PHY
config ETH_PHY_GEN_PHY_TX_DLY_10
	int "10Mbps TX delay"
	depends on NET_GPTP
	default 6066
	help
	  The default PHY interface to 10BASE-T Transmit Latency Timing.
	  Note: Default value is just an example taken from Marvell Alaska 1G
	  family datasheet.

config ETH_PHY_GEN_PHY_TX_DLY_100
	int "100Mbps TX delay"
	depends on NET_GPTP
	default 657
	help
	  The default PHY interface to 100BASE-TX Transmit Latency Timing.
	  Note: Default value is just an example taken from Marvell Alaska 1G
	  family datasheet.

config ETH_PHY_GEN_PHY_TX_DLY_1000
	int "1Gbps TX delay"
	depends on NET_GPTP
	default 147
	help
	  The default PHY interface to 1000BASE-T Transmit Latency Timing.
	  Note: Default value is just an example taken from Marvell Alaska 1G
	  family datasheet.

config ETH_PHY_GEN_PHY_RX_DLY_10
	int "10Mbps RX delay"
	depends on NET_GPTP
	default 2130
	help
	  10BASE-T to the default PHY interface Receive Latency Timing.
	  Note: Default value is just an example taken from Marvell Alaska 1G
	  family datasheet.

config ETH_PHY_GEN_PHY_RX_DLY_100
	int "100Mbps RX delay"
	depends on NET_GPTP
	default 362
	help
	  100BASE-TX to the default PHY interface Receive Latency Timing.
	  Note: Default value is just an example taken from Marvell Alaska 1G
	  family datasheet.

config ETH_PHY_GEN_PHY_RX_DLY_1000
	int "1Gbps RX delay"
	depends on NET_GPTP
	default 231
	help
	  1000BASE-T to the default PHY interface Receive Latency Timing.
	  Note: Default value is just an example taken from Marvell Alaska 1G
	  family datasheet.

endif
```

## drivers/x86/ethernet/Kconfig.eth_phy_marvell
```kconfig
# Kconfig - Marvell Phy driver configuration options

#
# Copyright (c) 2020 Intel Corporation
#
# SPDX-License-Identifier: Apache-2.0
#
menuconfig ETH_PHY_MARVELL
	bool
	prompt "Marvell Phy driver"
	depends on NET_L2_ETHERNET
	default n
	help
	  Enable Marvell Phy driver.

if ETH_PHY_MARVELL
config ETH_PHY_88E1512
	bool
	prompt "Marvell 88E1512 Phy driver"
	select ETH_PHY
	select ETH_PHY_USE_C22
	default n
	help
	  Enable Marvell 88E1512 Phy driver.

config ETH_PHY_88E1512_EEE
	bool "Energy Efficient Ethernet(EEE) enable"
	depends on ETH_PHY_88E1512
	select ETH_PHY_USE_C45
	default n
	help
	  Enable EEE for link speed 100MHz and 1000MHz to
	  help in saving energy or reducing power consumption
	  in the PHY when no data transmission.

if ETH_PHY_88E1512 && NET_GPTP

config ETH_PHY_88E1512_RGMII_TX_DLY_10
	int "10Mbps TX delay in RGMII mode"
	default 6066
	help
	  Marvell 88E1512 RGMII to 10BASE-T Transmit Latency Timing.
	  Default value is an average of TX latency mentioned in the
	  Marvell Alaska 1G family datasheet.

config ETH_PHY_88E1512_RGMII_TX_DLY_100
	int "100Mbps TX delay in RGMII mode"
	default 657
	help
	  Marvell 88E1512 RGMII to 100BASE-TX Transmit Latency Timing.
	  Default value is an average of TX latency mentioned in the
	  Marvell Alaska 1G family datasheet.

config ETH_PHY_88E1512_RGMII_TX_DLY_1000
	int "1Gbps TX delay in RGMII mode"
	default 147
	help
	  Marvell 88E1512 RGMII to 1000BASE-T Transmit Latency Timing.
	  Default value is an average of TX latency mentioned in the
	  Marvell Alaska 1G family datasheet.

config ETH_PHY_88E1512_SGMII_TX_DLY_10
	int "10Mbps TX delay in SGMII mode"
	default 5385
	help
	  Marvell 88E1512 SGMII to 10BASE-T Transmit Latency Timing.
	  Default value is an average of TX latency mentioned in the
	  Marvell Alaska 1G family datasheet.

config ETH_PHY_88E1512_SGMII_TX_DLY_100
	int "100Mbps TX delay in SGMII mode"
	default 666
	help
	  Marvell 88E1512 SGMII to 100BASE-TX Transmit Latency Timing.
	  Default value is an average of TX latency mentioned in the
	  Marvell Alaska 1G family datasheet.

config ETH_PHY_88E1512_SGMII_TX_DLY_1000
	int "1Gbps TX delay in SGMII mode"
	default 219
	help
	  Marvell 88E1512 SGMII to 1000BASE-T Transmit Latency Timing.
	  Default value is an average of TX latency mentioned in the
	  Marvell Alaska 1G family datasheet.

config ETH_PHY_88E1512_RGMII_RX_DLY_10
	int "10Mbps RX delay in RGMII mode"
	default 2130
	help
	  Marvell 88E1512 10BASE-T to RGMII Receive Latency Timing.
	  Default value is an average of RX latency mentioned in the
	  Marvell Alaska 1G family datasheet.

config ETH_PHY_88E1512_RGMII_RX_DLY_100
	int "100Mbps RX delay in RGMII mode"
	default 362
	help
	  Marvell 88E1512 100BASE-T to RGMII Receive Latency Timing.
	  Default value is an average of RX latency mentioned in the
	  Marvell Alaska 1G family datasheet.

config ETH_PHY_88E1512_RGMII_RX_DLY_1000
	int "1Gbps RX delay in RGMII mode"
	default 231
	help
	  Marvell 88E1512 1000BASE-T to RGMII Receive Latency Timing.
	  Default value is an average of RX latency mentioned in the
	  Marvell Alaska 1G family datasheet.

config ETH_PHY_88E1512_SGMII_RX_DLY_10
	int "10Mbps RX delay in SGMII mode"
	default 5903
	help
	  Marvell 88E1512 10BASE-T to SGMII Receive Latency Timing.
	  Default value is an average of RX latency mentioned in the
	  Marvell Alaska 1G family datasheet.

config ETH_PHY_88E1512_SGMII_RX_DLY_100
	int "100Mbps RX delay in SGMII mode"
	default 821
	help
	  Marvell 88E1512 100BASE-T to SGMII Receive Latency Timing.
	  Default value is an average of RX latency mentioned in the
	  Marvell Alaska 1G family datasheet.

config ETH_PHY_88E1512_SGMII_RX_DLY_1000
	int "1Gbps RX delay in SGMII mode"
	default 344
	help
	  Marvell 88E1512 1000BASE-T to SGMII Receive Latency Timing.
	  Default value is an average of RX latency mentioned in the
	  Marvell Alaska 1G family datasheet.

endif # ETH_PHY_88E1512 && NET_GPTP

endif # ETH_PHY_MARVELL
```

## drivers/x86/ethernet/Kconfig.phy
```kconfig
# Kconfig - Ethernet PHY driver framework configuration options

#
# Copyright (c) 2020 Intel Corporation
#
# SPDX-License-Identifier: Apache-2.0
#
menuconfig ETH_PHY
	bool "Ethernet PHY driver framework"
	depends on NET_L2_ETHERNET
	default n
	help
	  Enable Ethernet PHY driver framework.

if ETH_PHY
config ETH_PHY_DEBUG
	bool "Enable Debug"
	default n
	help
	  Enable debug mode to allow more status printing from PHY.

config ETH_PHY_USE_C22
	bool "MDIO C22"
	default n
	help
	  Enable PHY driver to use MDIO C22.

config ETH_PHY_USE_C45
	bool "MDIO C45"
	default n
	help
	  Enable PHY driver to use MDIO C45.

endif
```

## dts/bindings/can/intel,ia-can.yaml
```yaml
# Copyright (c) 2021 Intel Corporation
#
# SPDX-License-Identifier: Apache-2.0

---
description: Intel CAN controller

compatible: "intel,ia-can"

include: can-fd-controller.yaml

properties:
    reg:
      type: array
      description: register base address
      required: true

    interrupts:
      type: array
      required: true
      description: required interrupts

    peripheral-id:
      type: int
      description: peripheral ID
      required: true

    prop-seg:
      type: int
      required: true
      description: Time quantums of propagation segment (ISO 11898-1)

    phase-seg1:
      type: int
      required: true
      description: Time quantums of phase buffer 1 segment (ISO 11898-1)

    phase-seg2:
      type: int
      required: true
      description: Time quantums of phase buffer 2 segment (ISO 11898-1)

    prop-seg-data:
      type: int
      required: true
      description: Time quantums of propagation segment for the data phase. (ISO11898-1:2015)

    phase-seg1-data:
      type: int
      required: true
      description: Time quantums of phase buffer 1 segment for the data phase. (ISO11898-1:2015)

    phase-seg2-data:
      type: int
      required: true
      description: Time quantums of phase buffer 2 segment for the data phase. (ISO11898-1:2015)
...
```

## dts/bindings/dma/intel,ia-dma.yaml
```yaml
# Copyright (c) 2021 Intel Corporation
#
# SPDX-License-Identifier: Apache-2.0
---
description: INTEL IA DMA controller.

compatible: "intel,ia-dma"

include: dma-controller.yaml

properties:
    reg:
      required: true

    peripheral-id:
      type: int
      description: peripheral instance in DMA controller.
      required: true
```

## dts/bindings/ipc/intel,ipc.yaml
```yaml
# Copyright (c) 2019-2021 Intel Corporation
#
# SPDX-License-Identifier: Apache-2.0
---
description: INTEL IPC controller.

compatible: "intel,ipc"

include: base.yaml

properties:
    reg:
      required: true

    label:
      required: true

    interrupts:
      required: true

    timeout-ms:
      type: int
      required: true
      description: write timeout in ms

    peripheral-id:
      type: int
      description: Peripheral instance id
      required: true
...
```

## dts/bindings/mmc/intel,ia-emmc.yaml
```yaml
# Copyright (c) 2021 Intel Corporation
#
# SPDX-License-Identifier: Apache-2.0
---
description: INTEL IA eMMC controller.

compatible: "intel,ia-emmc"

include: mmc.yaml

properties:
    reg:
      required: true
```
